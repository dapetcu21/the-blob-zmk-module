## boards/shields/the_blob/Kconfig.defconfig
```kconfig
if SHIELD_THE_BLOB_LEFT

# Name must be less than 16 characters long!
config ZMK_KEYBOARD_NAME
    default "The Blob"

config ZMK_SPLIT_ROLE_CENTRAL
    default y

config ZMK_SPLIT_BLE_CENTRAL_BATTERY_LEVEL_PROXY
    default y

config ZMK_SPLIT_BLE_CENTRAL_BATTERY_LEVEL_FETCHING
    default y

endif

if SHIELD_THE_BLOB_LEFT || SHIELD_THE_BLOB_RIGHT

config ZMK_SPLIT
    default y

config ZMK_SLEEP
    default y

config ZMK_POINTING
    default y

endif
```

## boards/shields/the_blob/Kconfig.shield
```kconfig
config SHIELD_THE_BLOB_LEFT
    def_bool $(shields_list_contains,the_blob_left)

config SHIELD_THE_BLOB_RIGHT
    def_bool $(shields_list_contains,the_blob_right)
```
